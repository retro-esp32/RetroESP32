## Components/gogo/components/odroid/Kconfig.projbuild
```kconfig
menu "LCD Screen Driver"

    choice LCD_DRIVER_CHIP
        prompt "LCD Driver Chip"
        default LCD_DRIVER_CHIP_ODROID_GO
        help
            Select Your LCD Driver

    config LCD_DRIVER_CHIP_ODROID_GO
        bool "Odroid Go Default (ILI9341) [2.4\"]"

    config LCD_DRIVER_CHIP_RETRO_ESP32
        bool "Retro ESP32 (ILI9342) [2.6\"]"

    endchoice

endmenu

menu "Menu Hot Keys"

    choice MENU_HOT_KEYS
        prompt "Menu Hot Keys Option"
        default DEFAULT_MENU_KEY
        help
            Select Hot Key (Menu Button)

    config DEFAULT_MENU_KEY
        bool "Default Odroid Go MENU Button"

    config COMBO_MENU_KEY
        bool "Use START + SELECT buttons for MENU"

    endchoice

endmenu
```

## Components/handy-go/components/odroid/Kconfig.projbuild
```kconfig
menu "LCD Screen Driver"

    choice LCD_DRIVER_CHIP
        prompt "LCD Driver Chip"
        default LCD_DRIVER_CHIP_ODROID_GO
        help
            Select Your LCD Driver

    config LCD_DRIVER_CHIP_ODROID_GO
        bool "Odroid Go Default (ILI9341) [2.4\"]"

    config LCD_DRIVER_CHIP_RETRO_ESP32
        bool "Retro ESP32 (ILI9342) [2.6\"]"

    endchoice

endmenu

menu "Retro ESP32 - In Game Menu"

    choice IN_GAME_MENU
        prompt "Use Retro ESP32 - In Game Menu"
        default IN_GAME_MENU_NO
        help
            Use Retro ESP32 - In Game Menu

    config IN_GAME_MENU_YES
        bool "Yes"

    config IN_GAME_MENU_NO
        bool "No"

    endchoice

endmenu

menu "Menu Hot Keys"

    choice MENU_HOT_KEYS
        prompt "Menu Hot Keys Option"
        default DEFAULT_MENU_KEY
        help
            Select Hot Key (Menu Button)

    config DEFAULT_MENU_KEY
        bool "Default Odroid Go MENU Button"

    config COMBO_MENU_KEY
        bool "Use START + SELECT buttons for MENU"

    endchoice

endmenu
```

## Components/odroid-go-firmware/main/Kconfig.projbuild
```kconfig
menu "Retro ESP32 Configuration"
    choice LCD_DRIVER_CHIP
        prompt "LCD Driver Chip"
        default LCD_DRIVER_CHIP_ODROID_GO
        help
            LCD Screen Driver

    config LCD_DRIVER_CHIP_ST7789
        bool "Cute ESP32 - 2\" [ST7789]"

    config LCD_DRIVER_CHIP_ODROID_GO
        bool "Odroid Go - 2.4\" [ILI9341]"

    config LCD_DRIVER_CHIP_RETRO_ESP32
        bool "Retro ESP32 - 2.6\" [ILI9342]"

    config LCD_DRIVER_CHIP_RETRO_ESP32_V2
        bool "Retro ESP32 V2 - 2.6\" [ILI9342C]"        

    endchoice

    choice MENU_HOT_KEYS
        prompt "MENU Key Options"
        default DEFAULT_MENU_KEY
        help
            Select Hot Key (Menu Button)

    config DEFAULT_MENU_KEY
        bool "Odroid Go MENU Button"

    config COMBO_MENU_KEY
        bool "START + SELECT as MENU button"

    endchoice
endmenu    
```

## Components/prosystem-odroid-go/components/odroid/Kconfig.projbuild
```kconfig
menu "Retro ESP32 Configuration"
    choice LCD_DRIVER_CHIP
        prompt "LCD Driver Chip"
        default LCD_DRIVER_CHIP_ODROID_GO
        help
            LCD Screen Driver

    config LCD_DRIVER_CHIP_ODROID_GO
        bool "Odroid Go - 2.4\" [ILI9341]"

    config LCD_DRIVER_CHIP_RETRO_ESP32
        bool "Retro ESP32 - 2.6\" [ILI9342]"

    endchoice

    choice MENU_HOT_KEYS
        prompt "MENU Key Options"
        default DEFAULT_MENU_KEY
        help
            Select Hot Key (Menu Button)

    config DEFAULT_MENU_KEY
        bool "Odroid Go MENU Button"

    config COMBO_MENU_KEY
        bool "START + SELECT as MENU button"

    endchoice

    choice IN_GAME_MENU
        prompt "In Game Menu"
        default IN_GAME_MENU_YES
        help
            Use Retro ESP32 - In Game Menu

    config IN_GAME_MENU_YES
        bool "YES"

    config IN_GAME_MENU_NO
        bool "NO"

    endchoice
endmenu
```

## Launchers/esplay-retro-emulation/drivers/Kconfig.projbuild
```kconfig
menu "LittleV Graphics Library"

config USE_LVGL_LIBRARY
	bool "Use LVGL library"

config USE_LVGL
	int
	default 1 if USE_LVGL_LIBRARY

endmenu

menu "SDCard Configuration"

config SDIO_DAT2_DISABLED
    bool "Disable the DAT2 in SDIO slave"
    default y
    help
        SDIO slave DAT pin is unfortunately the same pin as MTDI, which
        controls the flash power voltage. For 3.3v flash devkits / modules /
        kits, it conflicts with the DAT2 pullups required by the
        specification.
        
        This disables the peripheral input from the DAT2 so that we can work
        in 1-bit mode when DAT2 is floating (pulled down). 4-bit mode is
        therefore unavailable.

endmenu

menu "Hardware configuration"

choice EMULATOR_HARDWARE
	prompt "Hardware to run on"
	default ESPLAY20_HW
	help
		This emulator can run on various types of hardware. Select what you have here.

config ESPLAY20_HW
	bool "ESPlay 2.0 Hardware"

config ESPLAY_MICRO_HW
	bool "ESPlay Micro Hardware (not released yet)"

config HW_CUSTOM
	bool "Custom hardware"

endchoice

choice HW_LCD_TYPE_SEL
	prompt "LCD type"
	default HW_LCD_TYPE_ILI9341
	depends on HW_CUSTOM

config HW_LCD_TYPE_ILI9341
	bool "ILI9341 LCD"

config HW_LCD_TYPE_ILI9342
	bool "ILI9342 LCD"

endchoice

config HW_LCD_TYPE
	int
	default 0 if ESPLAY20_HW
    default 0 if ESPLAY_MICRO_HW
	default 0 if HW_LCD_TYPE_ILI9341
	default 1 if HW_LCD_TYPE_ILI9342

endmenu
```

## Launchers/retro-esp32-next/components/spi_lcd/Kconfig.projbuild
```kconfig
menu "Retro ESP32 Configuration"
    choice LCD_DRIVER_CHIP
        prompt "LCD Driver Chip"
        default LCD_DRIVER_ILI9341
        help
            LCD Screen Driver

    config LCD_DRIVER_ILI9341
        bool "ILI9341"

    config LCD_DRIVER_ILI9342
        bool "ILI9342/C"

    endchoice

    choice MENU_HOT_KEYS
        prompt "MENU Key Options"
        default DEFAULT_MENU_KEY
        help
            Select Hot Key (Menu Button)

    config DEFAULT_MENU_KEY
        bool "Odroid Go MENU Button"

    config COMBO_MENU_KEY
        bool "START + SELECT as MENU button"

    endchoice
endmenu    
```

## Launchers/retro-esp32/Kconfig.projbuild
```kconfig
menu "LCD Screen Driver"

    choice LCD_DRIVER_CHIP
        prompt "LCD Driver Chip"
        default LCD_DRIVER_CHIP_RETRO_ESP32
        help
            Select Your LCD Driver

    config LCD_DRIVER_CHIP_DEFAULT
        bool "Odroid Go Default (ILI9341) [2.4\"]"

    config LCD_DRIVER_CHIP_RETRO_ESP32
        bool "Retro ESP32 (ILI9342) [2.6\"]"

    endchoice

endmenu
```
